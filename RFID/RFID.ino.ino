/*

Este código reconhece um cartão e acende LEDs

*/
//biblioteca do monitor
#include <Arduino.h>
#include <Wire.h>
#include <MicroLCD.h>

//biblioteca do RFID
#include <SPI.h>
#include <MFRC522.h>

// pinos do RFID
#define SS_PIN 10
#define RST_PIN 9
MFRC522 mfrc522(SS_PIN, RST_PIN);

//pino do alarme
#define BUZZER 5 

//CONFIGURACAO DO DISPLAY MICRO LCD
LCD_SSD1306 lcd;

//Demostração de imagem no LCD
const PROGMEM uint8_t logo[48 * 48 / 8] = {
0x00, 0x00, 0x00, 0x00, 0x00, 0x00, 0x00, 0x00, 0x00, 0x00, 0x00, 0x80, 0xC0, 0xC0, 0xE0, 0xE0,
0xF0, 0xF0, 0xF8, 0xF8, 0xF8, 0xF8, 0xF8, 0x18, 0x18, 0xF8, 0xF8, 0xF8, 0xF8, 0xF8, 0xF0, 0xF0,
0xE0, 0xE0, 0xC0, 0xC0, 0x80, 0x00, 0x00, 0x00, 0x00, 0x00, 0x00, 0x00, 0x00, 0x00, 0x00, 0x00,
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0x07, 0x03, 0x03, 0x01, 0x00, 0x00, 0x00, 0x00, 0x00, 0x00, 0x00, 0x00, 0x00, 0x00, 0x00, 0x00
};

void setup() 
{
  //Monitor Serial
  Serial.begin(9600);
  //RFID   
  SPI.begin();      
  mfrc522.PCD_Init(); 
  //LEDs  
  pinMode(6, OUTPUT);
  pinMode(7, OUTPUT);
  //LCD
  lcd.begin();
}

void tocaSom(int frequencia) {
 tone(BUZZER,frequencia, 100);
}
void alerta(){
  lcd.clear();
  lcd.setFontSize(FONT_SIZE_SMALL);
  lcd.println("Analise concluida:");
  lcd.println(" ");
  lcd.setFontSize(FONT_SIZE_MEDIUM);
  lcd.println("Entrada");
  lcd.println("nao autorizada");
  delay(1000);
}
void ok(){
  lcd.clear();
  lcd.setFontSize(FONT_SIZE_SMALL);
  lcd.println("Analise concluida");
  lcd.println(" ");
  lcd.setFontSize(FONT_SIZE_MEDIUM);
  lcd.println("Bem vindo");
  lcd.println("Pedro Cordeiro");
  delay(1000);
}
void limpa(){
  //Linpa o LCD e mostra a imagem
  lcd.clear();
  lcd.setFontSize(FONT_SIZE_MEDIUM);
  lcd.println("Analisando:");
  lcd.setCursor(40, 2);
  lcd.draw(logo, 48, 48);
  delay(1000);
}
void loop() 
{
  limpa(); 
  if ( ! mfrc522.PICC_IsNewCardPresent()) 
  {
    return;
  }
  if ( ! mfrc522.PICC_ReadCardSerial()) 
  {
    return;
  }
  
  Serial.print("Identificação do cartao:");
  String conteudo= "";
  byte letra;
  for (byte i = 0; i < mfrc522.uid.size; i++) 
  {
     Serial.print(mfrc522.uid.uidByte[i] < 0x10 ? " 0" : " ");
     Serial.print(mfrc522.uid.uidByte[i], HEX);
     conteudo.concat(String(mfrc522.uid.uidByte[i] < 0x10 ? " 0" : " "));
     conteudo.concat(String(mfrc522.uid.uidByte[i], HEX));
  }
  
  Serial.println();
  Serial.print("Mensagem : ");
  conteudo.toUpperCase();
 
  if (conteudo.substring(1) == "79 17 44 B8") //cartao 1
  {
    Serial.println("Entrada não autorizada!");
    Serial.println();
    alerta();
    digitalWrite(7, HIGH); // ativa led vermelho
    tocaSom(2800);
    delay(500);           // espera 3 segundos
    digitalWrite(7, LOW);  // desativa led vermelho
    tocaSom(0);
    delay(500); 
    digitalWrite(7, HIGH);
    tocaSom(2800); 
    delay(500);           
    digitalWrite(7, LOW);
    tocaSom(0);
    delay(500); 
    digitalWrite(7, HIGH);
    tocaSom(2800);
    delay(500);          
    digitalWrite(7, LOW);
    tocaSom(0);
    limpa();
  }  

   if (conteudo.substring(1) == "9A 89 76 1A") //cartao 2
  {
    Serial.println("Bem vindo de Volta Pedro Cordeiro!");
    Serial.println();
    ok();
    digitalWrite(6, HIGH); // ativa led verde
    tocaSom(2800);
    delay(250);                 // espera 3 segundos
    digitalWrite(6, LOW); // desativa led verde
    tocaSom(0);
    delay(250); 
    digitalWrite(6, HIGH);
    tocaSom(2800); 
    delay(250);          
    digitalWrite(6, LOW);
    tocaSom(0);
    limpa();
  }  
}
